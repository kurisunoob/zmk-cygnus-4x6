## boards/shields/cygnus/Kconfig.defconfig
```kconfig
if SHIELD_CYGNUS_DONGLE

config ZMK_KEYBOARD_NAME
    default "Cygnus Dongle"

config ZMK_SPLIT_ROLE_CENTRAL
    default y

config ZMK_SPLIT
    default y

config ZMK_SPLIT_BLE_CENTRAL_PERIPHERALS
    default 2

config BT_MAX_CONN
    default 3

config ZMK_COMBO_MAX_COMBOS_PER_KEY
    default 7

config BT_MAX_PAIRED
    default 3

config ZMK_SPLIT
    default y

config ZMK_SPLIT_BLE_CENTRAL_PERIPHERALS
    default 2          # ← 两个半，必须改成 2

config BT_MAX_CONN
    default 7          # 2个外设 + 5个蓝牙 profile（推荐）

config BT_MAX_PAIRED
    default 7

endif

if SHIELD_CYGNUS_LEFT || SHIELD_CYGNUS_RIGHT

config ZMK_SPLIT
    default y

endif
```
