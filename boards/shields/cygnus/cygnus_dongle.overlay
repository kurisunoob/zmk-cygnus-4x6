#include "cygnus.dtsi" 
/ {
    chosen {
        zmk,kscan = &mock_kscan;
        zmk,matrix_transform = &default_transform;
    };

    mock_kscan: kscan_mock {
        compatible = "zmk,kscan-mock";
        columns = <12>;
        rows = <4>;
        events = <0>;
    };
};
